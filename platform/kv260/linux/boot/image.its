## platform/kv260/linux/boot/image.its
```
/dts-v1/;
/ {
    description = "z486 XL KV260 SD Linux";
    #address-cells = <1>;
    images {
        kernel {
            description = "Linux arm64";
            data = /incbin/("Image");
            type = "kernel";
            arch = "arm64";
            os = "linux";
            compression = "none";
            load = <0x00200000>;
            entry = <0x00200000>;
            hash { algo = "sha256"; };
        };
        fdt-a {
            data = /incbin/("kv260-revA.dtb");
            type = "flat_dt";
            arch = "arm64";
            compression = "none";
            hash { algo = "sha256"; };
        };
        fdt-b {
            data = /incbin/("kv260-revB.dtb");
            type = "flat_dt";
            arch = "arm64";
            compression = "none";
            hash { algo = "sha256"; };
        };
    };
    configurations {
        default = "conf-kv260-revB";
        conf-kv260-revA { kernel = "kernel"; fdt = "fdt-a"; };
        conf-kv260-revB { kernel = "kernel"; fdt = "fdt-b"; };
    };
};
```

## platform/kv260/linux/meta-z486-xl/conf/layer.conf
```bitbake
BBPATH .= ":${LAYERDIR}"
BBFILES += "${LAYERDIR}/recipes-*/*/*.bb ${LAYERDIR}/recipes-*/*/*.bbappend"
BBFILE_COLLECTIONS += "z486-xl"
BBFILE_PATTERN_z486-xl = "^${LAYERDIR}/"
BBFILE_PRIORITY_z486-xl = "10"
LAYERSERIES_COMPAT_z486-xl = "scarthgap"
LAYERDEPENDS_z486-xl = "core"
```
